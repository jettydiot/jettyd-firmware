## drivers/camera/Kconfig
```kconfig
menu "Camera Driver"

config JETTYD_CAMERA_SUPPORTED
    bool "Enable camera driver (OV2640)"
    default y if IDF_TARGET_ESP32S3
    default n
    depends on IDF_TARGET_ESP32S3
    help
        Compile the full OV2640 camera implementation.
        On non-camera targets (esp32c3, esp32c6) this is automatically
        disabled and camera_register() compiles to a no-op stub so all
        CI matrix legs remain green.

config JETTYD_CAMERA_SETTLE_FRAMES
    int "AE/AWB settle frames to discard after sensor init"
    default 5
    range 0 30
    depends on JETTYD_CAMERA_SUPPORTED
    help
        Number of frames to grab and immediately discard right after the
        OV2640 is initialised, before the first frame that gets uploaded.

        The sensor's first frames after power-up are underexposed (the very
        first is typically pitch black); auto-exposure and auto-white-balance
        converge only after several frames. Discarding these settle frames
        ensures a grant-triggered capture never uploads a black/garbage frame.

        Default 5 (matches the ~3-5 frame convergence seen during P4 camera
        bring-up). Set to 0 to disable settling.

endmenu
```

## jettyd/Kconfig.projbuild
```kconfig
menu "jettyd configuration"

    config JETTYD_FLEET_TOKEN
        string "Fleet token"
        default ""
        help
            Fleet token from api.jettyd.com/v1/fleet-tokens.
            Used on first boot to provision the device.
            After provisioning this is replaced by a per-device key.

    config JETTYD_MQTT_URI
        string "MQTT broker URI"
        default "mqtt://mqtt.jettyd.com:1883"
        help
            URI of the jettyd MQTT broker.

    config JETTYD_WIFI_SSID
        string "WiFi SSID"
        default ""
        help
            Your WiFi network name.

    config JETTYD_WIFI_PASSWORD
        string "WiFi password"
        default ""
        help
            Your WiFi password. Leave empty for open networks.

    config JETTYD_FIRMWARE_VERSION
        string "Firmware version"
        default "0.1.0"
        help
            Firmware version string reported to the platform.

    config JETTYD_DEVICE_TYPE
        string "Device type slug"
        default "esp32-generic"
        help
            Device type slug from api.jettyd.com/v1/device-types.
            Used during provisioning to identify the hardware.

    config JETTYD_WIFI_SET_TIMEOUT_MS
        int "wifi.set reconnect timeout (ms)"
        default 30000
        range 5000 120000
        help
            How long the `wifi.set` device command waits for the new network to
            reach a connected state before rolling back to the previous WiFi
            credentials and reporting failure.

    config JETTYD_WIFI_PORTAL
        bool "Enable SoftAP fallback config portal"
        default y
        help
            When enabled, a SoftAP + embedded HTTP config portal starts when
            station WiFi cannot connect after JETTYD_WIFI_PORTAL_FAIL_THRESHOLD
            consecutive attempts and the portal is armed. Users connect to the
            AP (SSID: jettyd-<id>) and open http://192.168.4.1 to enter new
            WiFi credentials. Set to n to compile out all portal code and data.

    config JETTYD_WIFI_PORTAL_FAIL_THRESHOLD
        int "Consecutive WiFi failures before portal trigger"
        depends on JETTYD_WIFI_PORTAL
        default 5
        range 1 20
        help
            Number of consecutive station connection failures required before
            the config portal is considered. The portal also requires arming
            (fresh device, boot window, or button held) to actually start.

    config JETTYD_WIFI_PORTAL_BOOT_WINDOW_S
        int "Portal arming boot window (seconds)"
        depends on JETTYD_WIFI_PORTAL
        default 300
        range 30 3600
        help
            The portal is armed (eligible to start) for this many seconds after
            power-on. Outside this window a WiFi jammer cannot summon the AP on
            an unattended, long-running device unless the button is held.

    config JETTYD_WIFI_PORTAL_TIMEOUT_S
        int "Portal idle timeout (seconds)"
        depends on JETTYD_WIFI_PORTAL
        default 600
        range 60 3600
        help
            Seconds of HTTP inactivity before the config portal stops and the
            device reboots to resume the station retry loop.

endmenu
```
